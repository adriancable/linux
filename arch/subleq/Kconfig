## arch/subleq/Kconfig
```kconfig
# SPDX-License-Identifier: GPL-2.0
# Subleq architecture configuration

config SUBLEQ
	def_bool y
	select ARCH_32BIT_OFF_T
	select GENERIC_ATOMIC64
	select GENERIC_CSUM
	select GENERIC_HWEIGHT
	select GENERIC_IRQ_SHOW
	select GENERIC_CPU_DEVICES
	select LEGACY_TIMER_TICK
	select OF_EARLY_FLATTREE if OF
	select NO_IOPORT_MAP
	select SET_FS
	select TRACE_IRQFLAGS_SUPPORT
	select UACCESS_MEMCPY
	select ARCH_HAS_STRNCPY_FROM_USER
	select ARCH_HAS_STRNLEN_USER
	select HAVE_PREEMPT_LAZY
	select ARCH_SUPPORTS_LTO_CLANG
	help
	  Subleq is a One Instruction Set Computer (OISC) where the only
	  operation is "subtract and branch if less than or equal to zero."
	  This port runs on the Subleq virtual machine.

config MMU
	def_bool n

config NOMMU
	def_bool !MMU

config GENERIC_BUG
	def_bool y
	depends on BUG

config GENERIC_CALIBRATE_DELAY
	def_bool n

config GENERIC_HWEIGHT
	def_bool y

config GENERIC_CSUM
	def_bool y

config NO_IOPORT_MAP
	def_bool y

config STACKTRACE_SUPPORT
	def_bool y

config LOCKDEP_SUPPORT
	def_bool y

config PGTABLE_LEVELS
	int
	default 1

config ARCH_FORCE_MAX_ORDER
	int
	default 15
	help
	  The maximum page allocation order for the buddy allocator.
	  On NOMMU systems, ELF binaries must be loaded into contiguous
	  memory. Default of 15 allows allocations up to 128MB (2^15 pages).

config PHYS_ADDR_T_64BIT
	def_bool n

config ARCH_SUPPORTS_UPROBES
	def_bool n

# Subleq doesn't have display hardware, so disable virtual terminal support
config VT
	def_bool n

config LEGACY_PTYS
	def_bool n
config CMDLINE
	string "Default kernel command string"
	default ""
	help
	  On Subleq, command line arguments can be built into the kernel.
	  Enter any boot arguments here.

config CMDLINE_FORCE
	bool "Always use the default kernel command string"
	default y
	help
	  Always use the built-in command line, ignoring any passed by bootloader.

config HZ
	int
	default 100

source "kernel/Kconfig.hz"
```

## arch/subleq/Kconfig.debug
```kconfig
# SPDX-License-Identifier: GPL-2.0
# Subleq debugging configuration

menu "Kernel hacking"

config EARLY_PRINTK
	def_bool y
	help
	  Early printk support using Subleq's putchar instruction.

endmenu
```

## arch/subleq/configs/defconfig
```kconfig
# SPDX-License-Identifier: GPL-2.0
# Minimal defconfig for Subleq

# CONFIG_MMU is not set
# CONFIG_SMP is not set
CONFIG_SUBLEQ=y

# Basic kernel features
CONFIG_PRINTK=y
CONFIG_PRINTK_TIME=y
CONFIG_BUG=y
# CONFIG_MODULES is not set
# CONFIG_BLOCK is not set

# Preemption - full preemption for debugging
CONFIG_PREEMPT=y

# Enable POSIX timers (experiment)
CONFIG_POSIX_TIMERS=y

# Timer frequency
CONFIG_HZ_100=y

# Minimal required options
CONFIG_SYSFS=y
CONFIG_PROC_FS=y

# File systems
# CONFIG_EXT2_FS is not set
# CONFIG_EXT4_FS is not set
CONFIG_TMPFS=y

# Device and initramfs support
CONFIG_DEVTMPFS=y
CONFIG_DEVTMPFS_MOUNT=y
CONFIG_BLK_DEV_INITRD=y
CONFIG_INITRAMFS_SOURCE="../initramfs_root ../initramfs_setup.txt"
CONFIG_INITRAMFS_ROOT_UID="squash"
CONFIG_INITRAMFS_ROOT_GID="squash"
CONFIG_INITRAMFS_COMPRESSION_NONE=y

# No networking
# CONFIG_NET is not set

# Binary format support (using custom binfmt_elf_subleq.c)
# CONFIG_BINFMT_FLAT is not set

# No drivers
# CONFIG_SERIAL_8250 is not set

# CONFIG_VT is not set
# CONFIG_HW_CONSOLE is not set
# CONFIG_LEGACY_PTYS is not set

# Early console
CONFIG_EARLY_PRINTK=y

# Command line
CONFIG_CMDLINE="console=ttyS0 loglevel=7 rdinit=/sbin/init HOME=/root"
CONFIG_CMDLINE_FORCE=y

# Disable debugging (too much output)
# CONFIG_DEBUG_KERNEL is not set
# CONFIG_DEBUG_INFO is not set

# Disable unnecessary initramfs compression formats (we use uncompressed)
# CONFIG_RD_GZIP is not set
# CONFIG_RD_BZIP2 is not set
# CONFIG_RD_LZMA is not set
# CONFIG_RD_XZ is not set
# CONFIG_RD_LZO is not set
# CONFIG_RD_LZ4 is not set
# CONFIG_RD_ZSTD is not set

# Disable partition table support (no disk devices)
# CONFIG_MSDOS_PARTITION is not set
# CONFIG_EFI_PARTITION is not set

# Disable unused subsystems
# CONFIG_FW_LOADER is not set
# CONFIG_INPUT is not set
# CONFIG_SERIO is not set
# CONFIG_HID_SUPPORT is not set
# CONFIG_USB_SUPPORT is not set
# CONFIG_RUNTIME_TESTING_MENU is not set
```
